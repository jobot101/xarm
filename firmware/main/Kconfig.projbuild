## firmware/main/Kconfig.projbuild
```kconfig
menu "xArm Voice"

    config XARM_WIFI_SSID
        string "WiFi SSID (blank = AP mode only)"
        default ""

    config XARM_WIFI_PASS
        string "WiFi password"
        default ""

    config XARM_AP_PASS
        string "Fallback AP password (8+ chars, blank = open)"
        default "ragamuffin"

    config XARM_UART_TX
        int "UART TX -> xArm controller RX"
        default 5

    config XARM_UART_RX
        int "UART RX <- xArm controller TX"
        default 6

    config XARM_I2C_SDA
        int "I2C SDA (onboard bus, shared with codecs + header)"
        default 11

    config XARM_I2C_SCL
        int "I2C SCL"
        default 10

    config XARM_MIC_GAIN_DB
        int "Mic gain dB (AFE AGC makes up the rest)"
        default 24

    config XARM_VOICE_THRESHOLD
        int "MultiNet detect threshold (percent, lower = more sensitive)"
        default 22

    config XARM_MIC_DUAL
        bool "Default: use the second mic too (ES7210 MIC2, TDM slot 2) for beamforming"
        default n
        help
            Off: AFE input "MR" (mic1 + speaker reference), the layout xiaozhi uses on this board.
            On: "MRM" adds MIC2 so the AFE's BSS can steer toward the talker.
            Only the default: Workshop -> Voice -> "Use both mics" saves the choice in NVS and reboots.

    config XARM_VOICE_VAD_HOLD_MS
        int "Weak matches count only if the VAD heard a voice within this many ms"
        default 3000

    config XARM_STT_URL
        string "Cloud ears: OpenAI-compatible speech-to-text endpoint"
        default "https://api.groq.com/openai/v1/audio/transcriptions"
        help
            Whisper over HTTPS after "Hey Muffin". The API key is pasted in the web app (stored in NVS,
            never in the build). Groq's free tier is the default.

    config XARM_STT_MODEL
        string "Cloud ears: model"
        default "whisper-large-v3"
        help
            Full large-v3: better than turbo with kids' voices, a little slower. Free on Groq.

    config XARM_INTENT_URL
        string "Cloud ears: intent check endpoint (OpenAI-compatible chat completions)"
        default "https://api.groq.com/openai/v1/chat/completions"

    config XARM_INTENT_MODEL
        string "Cloud ears: intent model (turns any wording into one of Muffin's commands)"
        default "llama-3.1-8b-instant"

    config XARM_STT_DAILY_MAX
        int "Cloud ears: most requests per day (then on-board only until the day rolls over)"
        default 1800
        help
            Groq's free tier allows about 2000 requests a day.

    config XARM_UPDATE_URL
        string "Auto-update base URL (manifest.json + xarm-voice.bin, trailing slash)"
        default "https://jobot101.github.io/xarm/fw/"

    config XARM_UPDATE_EVERY_S
        int "Auto-update check interval, seconds"
        default 60

    config XARM_VOLUME
        int "Speaker volume 0-100 (robot sounds)"
        default 70

    config XARM_CHATTER_MIN
        int "Idle chatter: say something this many minutes after play stops (0 = never)"
        default 5

    config XARM_SCHOOL_MIN
        int "Robot School: minutes of class per kid per day (default; Workshop -> School changes it)"
        default 20
        range 5 120

    config XARM_TZ
        string "Time zone (POSIX TZ) for when a School day starts"
        default "EST5EDT,M3.2.0,M11.1.0"

endmenu
```
